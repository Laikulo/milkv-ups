## br-milkv/Config.in
```kconfig
# Packages provided by milk-v explicitly
source "$BR2_EXTERNAL_MILKV_PATH/package/cmatrix/Config.in"
source "$BR2_EXTERNAL_MILKV_PATH/package/cvi-pinmux/Config.in"
source "$BR2_EXTERNAL_MILKV_PATH/package/duo-pinmux/Config.in"
source "$BR2_EXTERNAL_MILKV_PATH/package/ncnn/Config.in"
source "$BR2_EXTERNAL_MILKV_PATH/package/python-freetype/Config.in"
source "$BR2_EXTERNAL_MILKV_PATH/package/python-pinpong/Config.in"

# Packages extracted from SDK
source "$BR2_EXTERNAL_MILKV_PATH/package/milkvkernel/Config.in"
source "$BR2_EXTERNAL_MILKV_PATH/package/cvi-fiptool/Config.in"

# Toolchain from milkv-host-tools
source "$BR2_EXTERNAL_MILKV_PATH/toolchain/toolchain-external-milkv/Config.in.options"
```

## br-milkv/configs/milkv-duo_musl_riscv64_defconfig
```kconfig
BR2_riscv=y
BR2_TOOLCHAIN_EXTERNAL=y
BR2_TOOLCHAIN_EXTERNAL_MILKV=y
BR2_TARGET_LDFLAGS="-mcpu=c906fdv -march=rv64imafdcv0p7xthead -mcmodel=medany -mabi=lp64d"
BR2_WGET="wget --passive-ftp -nd -t 3"
BR2_SVN="svn --non-interactive"
BR2_SCP="scp"
BR2_SFTP="sftp"
BR2_BACKUP_SITE="http://sources.buildroot.net"
BR2_GNU_MIRROR="http://ftpmirror.gnu.org"
BR2_CPAN_MIRROR="http://cpan.metacpan.org"
BR2_OPTIMIZE_S=y
BR2_PER_PACKAGE_DIRECTORIES=y
BR2_TARGET_GENERIC_HOSTNAME="milkv-duo"
BR2_TARGET_GENERIC_ISSUE="Welcome to Milk-V Duo"
BR2_TARGET_GENERIC_ROOT_PASSWD="milkv"
BR2_ROOTFS_OVERLAY="$(BR2_EXTERNAL_MILKV_PATH)/board/milkv/milkv-duo/overlay"
BR2_ROOTFS_POST_IMAGE_SCRIPT="$(BR2_EXTERNAL_MILKV_PATH)/board/milkv/milkv-duo/mkimage.sh"
BR2_LINUX_KERNEL=y
BR2_LINUX_KERNEL_CUSTOM_VERSION=y
BR2_LINUX_KERNEL_CUSTOM_VERSION_VALUE="5.10.4"
BR2_LINUX_KERNEL_USE_ARCH_DEFAULT_CONFIG=y
BR2_LINUX_KERNEL_NEEDS_HOST_OPENSSL=y
BR2_LINUX_KERNEL_NEEDS_HOST_LIBELF=y
BR2_LINUX_KERNEL_EXT_MILKVKERNEL=y
BR2_PACKAGE_BUSYBOX_SHOW_OTHERS=y
BR2_PACKAGE_ALSA_UTILS=y
BR2_PACKAGE_ALSA_UTILS_AMIXER=y
BR2_PACKAGE_ALSA_UTILS_APLAY=y
BR2_PACKAGE_ALSA_UTILS_ARECORDMIDI=y
BR2_PACKAGE_SPIDEV_TEST=y
BR2_PACKAGE_STRACE=y
BR2_PACKAGE_E2FSPROGS=y
BR2_PACKAGE_E2FSPROGS_RESIZE2FS=y
BR2_PACKAGE_EVTEST=y
BR2_PACKAGE_PYTHON3=y
BR2_PACKAGE_PYTHON3_PY_PYC=y
BR2_PACKAGE_PYTHON_CERTIFI=y
BR2_PACKAGE_PYTHON_EVDEV=y
BR2_PACKAGE_PYTHON_LXML=y
BR2_PACKAGE_PYTHON_MODBUS_TK=y
BR2_PACKAGE_PYTHON_PILLOW=y
BR2_PACKAGE_PYTHON_PIP=y
BR2_PACKAGE_PYTHON_PSUTIL=y
BR2_PACKAGE_PYTHON_SMBUS_CFFI=y
BR2_PACKAGE_PYTHON_SPIDEV=y
BR2_PACKAGE_CA_CERTIFICATES=y
BR2_PACKAGE_LIBOPENSSL_BIN=y
BR2_PACKAGE_LIBOPENSSL_ENGINES=y
BR2_PACKAGE_FREETYPE=y
BR2_PACKAGE_JSON_C=y
BR2_PACKAGE_LIBCURL=y
BR2_PACKAGE_LIBCURL_CURL=y
BR2_PACKAGE_LIBCURL_VERBOSE=y
BR2_PACKAGE_DHCPCD=y
BR2_PACKAGE_DNSMASQ=y
BR2_PACKAGE_DROPBEAR=y
BR2_PACKAGE_NTP=y
BR2_PACKAGE_NTP_NTPDATE=y
BR2_PACKAGE_NTP_NTPTIME=y
BR2_PACKAGE_WGET=y
BR2_PACKAGE_WPA_SUPPLICANT=y
BR2_PACKAGE_WPA_SUPPLICANT_CLI=y
BR2_PACKAGE_WPA_SUPPLICANT_WPA_CLIENT_SO=y
BR2_PACKAGE_COREUTILS=y
BR2_PACKAGE_HTOP=y
BR2_PACKAGE_KMOD=y
BR2_PACKAGE_UTIL_LINUX_BINARIES=y
BR2_PACKAGE_UTIL_LINUX_UUIDD=y
BR2_TARGET_ROOTFS_EXT2=y
BR2_TARGET_ROOTFS_EXT2_4=y
BR2_TARGET_ROOTFS_EXT2_SIZE="200M"
BR2_TARGET_ROOTFS_TAR_XZ=y
BR2_PACKAGE_HOST_CMAKE=y
BR2_PACKAGE_HOST_GENIMAGE=y
BR2_PACKAGE_CMATRIX=y
BR2_PACKAGE_CVI_PINMUX=y
BR2_PACKAGE_DUO_PINMUX=y
BR2_PACKAGE_PYTHON_PINPONG=y
BR2_PACKAGE_MILKVKERNEL=y
BR2_PACKAGE_HOST_CVI_FIPTOOL=y
```

## br-milkv/package/cvi-fiptool/Config.in
```kconfig
config BR2_PACKAGE_HOST_CVI_FIPTOOL
	bool "host-cvi-fiptool"
	default n
	select BR2_PACKAGE_HOST_PYTHON3
	select BR2_PACKAGE_HOST_PYTHON3_XZ
	help
	  Tools used to build FIPs
```

## br-milkv/package/milkvkernel/Config.in
```kconfig
config BR2_PACKAGE_MILKVKERNEL
	bool "Milkv Kernel Package"
	help
	  This package includes kernel extensions extraceted form the milkv sdk
	  https://github.com/milkv-duo/duo-buildroot-sdk/tree/develop/linux_5.10
```
